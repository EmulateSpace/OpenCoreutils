## binutils/Kconfig
```kconfig
#
# library configuration
#
menu "core utilise tools configuration"

config OBJDUMP
	bool "objdump on utilse"
	select XMALLOC
	select ELF_API
	help
	  display information from object files


endmenu
```

## lib/Kconfig
```kconfig
#
# Library configuration
#
menu "Library Configuration"

config XMALLOC
	bool "xmalloc utils support"
	help
	  Safe malloc memory from libC

config ELF_API
	bool "ELF ABI"
	help
	  EFL application interface

endmenu
```
